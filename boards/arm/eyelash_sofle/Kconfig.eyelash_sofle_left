## boards/arm/eyelash_sofle/board.yml
```yaml
boards:
  - name: eyelash_sofle_left
    full_name: Eyelash Sofle Left
    vendor: eyelashperipherals
    socs:
      - name: nrf52840
  - name: eyelash_sofle_right
    full_name: Eyelash Sofle Right
    vendor: eyelashperipherals
    socs:
      - name: nrf52840
```
